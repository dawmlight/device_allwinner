## drivers/Kconfig
```kconfig
# none hdf driver configs
choice
    prompt "Enable Uart"
    default DRIVERS_HDF_PLATFORM_UART
    help
      Enable simple uart (without vfs) only for litekernel.
      Enable general uart (with vfs) for full code.

config DRIVERS_HDF_PLATFORM_UART
    bool "Enable HDF platform uart driver"
    depends on DRIVERS_HDF_PLATFORM
    help
      Answer Y to enable HDF platform uart driver.

config PLATFORM_UART_WITHOUT_VFS
    bool "Simple Uart"
config PLATFORM_NO_UART
    bool "NO Uart"
endchoice
```
